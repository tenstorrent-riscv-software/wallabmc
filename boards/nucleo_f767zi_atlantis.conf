## boards/qemu_cortex_m3.conf
```kconfig
# CI tests require telnet shell
CONFIG_SHELL_BACKEND_TELNET=y
CONFIG_SHELL_TELNET_SUPPORT_COMMAND=y
CONFIG_APP_NTP=n
CONFIG_RTC=n
CONFIG_REDFISH=n
CONFIG_APP_WEB=n
CONFIG_APP_WEB_TERMINAL=n
CONFIG_PERSISTENT_STORAGE=n
CONFIG_TEST_RANDOM_GENERATOR=y
CONFIG_TEST_CSPRNG_GENERATOR=y
CONFIG_NET_IF_MAX_IPV4_COUNT=2
CONFIG_NET_IF_MAX_IPV6_COUNT=2
CONFIG_SHELL=y
```

## boards/sifive/hifive_premier_p550_mcu/Kconfig.defconfig
```kconfig
# hifive_premier_p550_mcu board configuration

# SPDX-FileCopyrightText: © 2025-2026 Tenstorrent USA, Inc.
# SPDX-License-Identifier: Apache-2.0

if BOARD_HIFIVE_PREMIER_P550_MCU

config SPI_STM32_INTERRUPT
	default y
	depends on SPI

configdefault ETH_DRIVER
	default y

endif # BOARD_HIFIVE_PREMIER_P550_MCU
```

## boards/tenstorrent/atlantis_evb_mcu/Kconfig.defconfig
```kconfig
# atlantis_evb_mcu board configuration

# SPDX-FileCopyrightText: © 2026 Tenstorrent USA, Inc.
# SPDX-License-Identifier: Apache-2.0

if BOARD_ATLANTIS_EVB_MCU

configdefault ETH_DRIVER
	default y

endif # BOARD_ATLANTIS_EVB_MCU
```

## boards/tenstorrent/atlantis_slt_mcu/Kconfig.defconfig
```kconfig
# atlantis_slt_mcu board configuration

# SPDX-FileCopyrightText: © 2026 Tenstorrent USA, Inc.
# SPDX-License-Identifier: Apache-2.0

if BOARD_ATLANTIS_SLT_MCU

configdefault ETH_DRIVER
	default y

endif # BOARD_ATLANTIS_SLT_MCU
```
