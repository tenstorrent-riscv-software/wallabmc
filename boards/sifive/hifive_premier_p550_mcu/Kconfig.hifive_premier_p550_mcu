## boards/sifive/hifive_premier_p550_mcu/Kconfig.hifive_premier_p550_mcu
```kconfig
# SPDX-FileCopyrightText: © 2025-2026 Tenstorrent USA, Inc.
# SPDX-License-Identifier: Apache-2.0

config BOARD_HIFIVE_PREMIER_P550_MCU
	select SOC_STM32F407XE
```

## west.yml
```yaml
manifest:
  remotes:
    - name: zephyr
      url-base: https://github.com/zephyrproject-rtos

  projects:
    - name: zephyr
      remote: zephyr
      revision: v4.4.0
      import: true

  self:
    path: wallabmc
```
